## conf/layer.conf
```bitbake
EULA_FILE_ST:stm32mpmydemo = "${LAYERDIR}/conf/eula/${MACHINE}"
EULA_FILE_ST_MD5SUM:stm32mpmydemo = "8b505090fb679839cefbcc784afe8ce9"

#Inform bitbake for adding another location to search for licenses
LICENSE_PATH += "${LAYERDIR}/files/licenses"

# Set a variable to get the STM32MP MX BSP location
STM32MP_MY_DEMO_BASE = "${LAYERDIR}"

# This should only be incremented on significant changes that may
# cause compatibility issues with other layers
LAYERVERSION_meta-my-custo-layer = "1"

LAYERDEPENDS_meta-my-custo-layer = "stm-st-stm32mp-mx"

# We have a conf and classes directory, add to BBPATH
BBPATH .= ":${LAYERDIR}"

# We have recipes-* directories, add to BBFILES
BBFILES += "${LAYERDIR}/recipes-*/*/*.bb \
            ${LAYERDIR}/recipes-*/*/*.bbappend"

BBFILE_COLLECTIONS += "meta-my-custo-layer"
BBFILE_PATTERN_meta-my-custo-layer = "^${LAYERDIR}/"
BBFILE_PRIORITY_meta-my-custo-layer = "7"

LAYERDEPENDS_meta-my-custo-layer = "core"

# OpenEmbedded compatibility information
# This should only be incremented on significant changes that will
# cause compatibility issues with other layers
LAYERVERSION_meta-my-custo-layer = "1"
LAYERSERIES_COMPAT_meta-my-custo-layer = "kirkstone"
```
